VERSION ""

NS_ :

BS_:
BU_: AlignBus
BO_ 377 APPS: 8 AlignBus
   SG_ ReadyToDrive : 0|1@1+ (1,0) [0|1] "" Vector__XXX

BA_DEF_ BO_ "GenMsgBackgroundColor" STRING ;
BA_DEF_ BO_ "GenMsgForegroundColor" STRING ;
BA_ "GenMsgBackgroundColor" BO_ 377 "#000000";
BA_DEF_DEF_ "GenMsgBackgroundColor" "#ffffff";
BA_DEF_DEF_ "GenMsgForegroundColor" "#000000";
CM_ BO_ 377 "APPS message";
CM_ SG_ 377 ReadyToDrive "Ready_to_drive_signal,_1_on_0_off";
VAL_ 377 ReadyToDrive 0 "No Description";
